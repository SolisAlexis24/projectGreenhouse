## main/Kconfig.projbuild
```kconfig
menu "Configuration"
	config SSID
		string "ssid"
		default ""

	config PSSWD
		string "psswd"
		default ""

	config SERVER_IP
		string "server_ip"
		default "192.168.1.168"

	config SERVER_PORT
		int "port"
		range 0 65535
		default 42069

endmenu
```
